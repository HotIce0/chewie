## apps/chewie/Kconfig
```kconfig
#
# For a description of the syntax of this configuration file,
# see the file kconfig-language.txt in the NuttX tools repository.
#

config CHEWIE
	tristate "\"Chewie\""
	default n
	---help---
		Enable the \"Chewie\"

if CHEWIE
config CHEWIE_PROGNAME
	string "Program name"
	default "chewie"
	depends on BUILD_LOADABLE
	---help---
		This is the name of the program that will be use when the NSH ELF
		program is installed.

config CHEWIE_PRIORITY
	int "Chewie task priority"
	default 100

config CHEWIE_STACKSIZE
	int "Chewie stack size"
	default 2048

# 单元测试配置
config CHEWIE_ENABLE_UNIT_TEST
	bool "Chewie enable unit test"
	default false

# 飞控相关基本配置
menu "Chewie general config"
config CHEWIE_NUM_OF_CHANNELS
	int "Num of channels"
	---help---
		4 is the only avilible value now.
	default 4
endmenu

# 日志相关配置
menu "Chewie Log config"
config CHEWIE_ENABLE_LOG
	tristate "enable log feature"
	default n

if CHEWIE_ENABLE_LOG

## PWM日志相关配置
config CHEWIE_ENABLE_PWM_LOG
	tristate "enable pwm log feature"
	default n

if CHEWIE_ENABLE_PWM_LOG
config CHEWIE_ENABLE_PWM_LOG_DEBUG
	tristate "enable pwm debug level log"
	default n
config CHEWIE_ENABLE_PWM_LOG_INFO
	tristate "enable pwm info level log"
	default n
config CHEWIE_ENABLE_PWM_LOG_WARNING
	tristate "enable pwm warning level log"
	default n
config CHEWIE_ENABLE_PWM_LOG_ERROR
	tristate "enable pwm error level log"
	default n
endif

## I2C日志相关配置
config CHEWIE_ENABLE_I2C_LOG
	tristate "enable I2C log feature"
	default n

if CHEWIE_ENABLE_I2C_LOG
config CHEWIE_ENABLE_I2C_LOG_DEBUG
	tristate "enable I2C debug level log"
	default n
config CHEWIE_ENABLE_I2C_LOG_INFO
	tristate "enable I2C info level log"
	default n
config CHEWIE_ENABLE_I2C_LOG_WARNING
	tristate "enable I2C warning level log"
	default n
config CHEWIE_ENABLE_I2C_LOG_ERROR
	tristate "enable I2C error level log"
	default n
endif

## IMU日志相关配置
config CHEWIE_ENABLE_IMU_LOG
	tristate "enable IMU log feature"
	default n

if CHEWIE_ENABLE_IMU_LOG
config CHEWIE_ENABLE_IMU_LOG_DEBUG
	tristate "enable IMU debug level log"
	default n
config CHEWIE_ENABLE_IMU_LOG_INFO
	tristate "enable IMU info level log"
	default n
config CHEWIE_ENABLE_IMU_LOG_WARNING
	tristate "enable IMU warning level log"
	default n
config CHEWIE_ENABLE_IMU_LOG_ERROR
	tristate "enable IMU error level log"
	default n
endif

## MOTOR日志相关配置
config CHEWIE_ENABLE_MOTOR_LOG
	tristate "enable motor log feature"
	default n

if CHEWIE_ENABLE_MOTOR_LOG
config CHEWIE_ENABLE_MOTOR_LOG_DEBUG
	tristate "enable motor debug level log"
	default n
config CHEWIE_ENABLE_MOTOR_LOG_INFO
	tristate "enable motor info level log"
	default n
config CHEWIE_ENABLE_MOTOR_LOG_WARNING
	tristate "enable motor warning level log"
	default n
config CHEWIE_ENABLE_MOTOR_LOG_ERROR
	tristate "enable motor error level log"
	default n

endif

endif
endmenu

# MOTOR相关配置
menu "chewie motor config"
config CHEWIE_MOTOR_PWM_OUT_DEVICE_PATH_PREFIX
	string "motor: PWM device path prefix"
	default "/dev/pwm_out_motor_"

config CHEWIE_MOTOR_PWM_FREQUENCY
	int "motor: PWM frequency (Hz)"
	default 400

config CHEWIE_MOTOR_PWM_MIN_THROTTLE_PLUSE_US
	int "motor: min value of PWM in us"
	default 1000

config CHEWIE_MOTOR_PWM_MAX_THROTTLE_PLUSE_US
	int "motor: max value of PWM in us"
	default 2000

config CHEWIE_MOTOR_PWM_ARMED_THROTTLE_PLUSE_US
	int "motor: this value will setted to PWM in us when init(or armed)"
	default 900
endmenu

# SENSOR相关配置
menu "chewie sensor config"

menu "imu config"

config CHEWIE_IMU_JY901B
	tristate "enable imu_jy901b"
	default y
if CHEWIE_IMU_JY901B
config CHEWIE_IMU_JY901B_I2C
	tristate "use i2c procotol"
	default y
if CHEWIE_IMU_JY901B_I2C
config CHEWIE_IMU_JY901B_I2C_DEV_PATH
	string "set i2c dev path"
	default "/dev/i2c2"
config CHEWIE_IMU_JY901B_I2C_BUS
	int "set i2c bus"
	default 2
config CHEWIE_IMU_JY901B_I2C_FREQUENCY
	int "set i2c frequency (Hz)"
	default 400000
config CHEWIE_IMU_JY901B_I2C_SLAVE_ADDRESS
	int "set i2c slave address"
	default 80
endif
endif

endmenu

endmenu

endif
```

## apps/examples/myapp/Kconfig
```kconfig
#
# For a description of the syntax of this configuration file,
# see the file kconfig-language.txt in the NuttX tools repository.
#

config EXAMPLES_MYAPP
	tristate "\"MyApp\" example"
	default n
	---help---
		Enable the \"MyApp\" example

if EXAMPLES_MYAPP

config EXAMPLES_MYAPP_PROGNAME
	string "Program name"
	default "myapp"
	depends on BUILD_LOADABLE
	---help---
		This is the name of the program that will be use when the NSH ELF
		program is installed.

config EXAMPLES_MYAPP_PRIORITY
	int "MyApp task priority"
	default 100

config EXAMPLES_MYAPP_STACKSIZE
	int "MyApp stack size"
	default 2048

endif
```
